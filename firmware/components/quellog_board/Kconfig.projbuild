## firmware/components/quellog_board/Kconfig.projbuild
```kconfig
menu "Quellog E-Ink Firmware"

config QUELLOG_BOARD_TYPE_ZECTRIX_S3_EPAPER_4_2
    bool "zectrix-s3-epaper-4.2"
    default y
    depends on IDF_TARGET_ESP32S3
    help
        Default Quellog E-Ink development board.

config QUELLOG_BUTTON_UP_GPIO
    int "UP button GPIO"
    default 39
    range -1 48
    depends on QUELLOG_BOARD_TYPE_ZECTRIX_S3_EPAPER_4_2

config QUELLOG_BUTTON_DOWN_GPIO
    int "DOWN button GPIO"
    default 18
    range -1 48
    depends on QUELLOG_BOARD_TYPE_ZECTRIX_S3_EPAPER_4_2

config QUELLOG_BUTTON_CONFIRM_GPIO
    int "CONFIRM button GPIO"
    default 0
    range -1 48
    depends on QUELLOG_BOARD_TYPE_ZECTRIX_S3_EPAPER_4_2

config QUELLOG_EPD_SPI_HOST
    int "EPD SPI host"
    default 2
    range 0 3
    depends on QUELLOG_BOARD_TYPE_ZECTRIX_S3_EPAPER_4_2

config QUELLOG_EPD_DC_GPIO
    int "EPD DC GPIO"
    default 10
    range -1 48
    depends on QUELLOG_BOARD_TYPE_ZECTRIX_S3_EPAPER_4_2

config QUELLOG_EPD_CS_GPIO
    int "EPD CS GPIO"
    default 11
    range -1 48
    depends on QUELLOG_BOARD_TYPE_ZECTRIX_S3_EPAPER_4_2

config QUELLOG_EPD_SCK_GPIO
    int "EPD SCK GPIO"
    default 12
    range -1 48
    depends on QUELLOG_BOARD_TYPE_ZECTRIX_S3_EPAPER_4_2

config QUELLOG_EPD_MOSI_GPIO
    int "EPD MOSI GPIO"
    default 13
    range -1 48
    depends on QUELLOG_BOARD_TYPE_ZECTRIX_S3_EPAPER_4_2

config QUELLOG_EPD_RST_GPIO
    int "EPD RESET GPIO"
    default 9
    range -1 48
    depends on QUELLOG_BOARD_TYPE_ZECTRIX_S3_EPAPER_4_2

config QUELLOG_EPD_BUSY_GPIO
    int "EPD BUSY GPIO"
    default 8
    range -1 48
    depends on QUELLOG_BOARD_TYPE_ZECTRIX_S3_EPAPER_4_2

config QUELLOG_EPD_POWER_GPIO
    int "EPD power GPIO"
    default 6
    range -1 48
    depends on QUELLOG_BOARD_TYPE_ZECTRIX_S3_EPAPER_4_2

config QUELLOG_INPUT_DEBOUNCE_MS
    int "Button debounce in milliseconds"
    default 180
    range 50 1000

config QUELLOG_AUTO_REFRESH_SECONDS
    int "Timed refresh interval in seconds"
    default 1800
    range 5 3600

endmenu
```

## firmware/sdkconfig.defaults
```kconfig
CONFIG_IDF_TARGET="esp32s3"
CONFIG_COMPILER_CXX_EXCEPTIONS=y
CONFIG_COMPILER_CXX_RTTI=y
CONFIG_BOOTLOADER_LOG_LEVEL_INFO=y
CONFIG_ESP_MAIN_TASK_STACK_SIZE=8192
CONFIG_ESP_SYSTEM_EVENT_TASK_STACK_SIZE=4096
CONFIG_ESPTOOLPY_FLASHSIZE_16MB=y
CONFIG_ESPTOOLPY_FLASHMODE_QIO=y
CONFIG_ESP_DEFAULT_CPU_FREQ_MHZ_240=y
CONFIG_PARTITION_TABLE_CUSTOM=y
CONFIG_PARTITION_TABLE_OFFSET=0x8000
CONFIG_PARTITION_TABLE_CUSTOM_FILENAME="partitions.csv"
CONFIG_BT_ENABLED=y
CONFIG_BT_NIMBLE_ENABLED=y
CONFIG_BT_NIMBLE_ROLE_PERIPHERAL=y
CONFIG_BT_NIMBLE_ROLE_CENTRAL=n
CONFIG_BT_NIMBLE_ROLE_BROADCASTER=y
CONFIG_BT_NIMBLE_ROLE_OBSERVER=n
CONFIG_BT_NIMBLE_MAX_CONNECTIONS=1
CONFIG_BT_NIMBLE_HOST_TASK_STACK_SIZE=4096
CONFIG_FREERTOS_HZ=1000
CONFIG_HTTPD_MAX_REQ_HDR_LEN=2048
CONFIG_HTTPD_MAX_URI_LEN=2048
```
